## conf/layer.conf
```bitbake
# We have a conf and classes directory, add to BBPATH
BBPATH .= ":${LAYERDIR}"

# We have recipes-* directories, add to BBFILES
BBFILES += "${LAYERDIR}/recipes-*/*/*.bb \
            ${LAYERDIR}/recipes-*/*/*.bbappend"

BBFILE_COLLECTIONS += "meta-plantwire"
BBFILE_PATTERN_meta-plantwire = "^${LAYERDIR}/"
BBFILE_PRIORITY_meta-plantwire = "6"

LAYERDEPENDS_meta-plantwire = "core"
LAYERSERIES_COMPAT_meta-plantwire = "honister"
```
